## firmware/components/board_support/Kconfig
```kconfig
menu "Audio validation board"

choice BOARD_SD_PROFILE
    prompt "XIAO ESP32-S3 Sense microSD pin profile"
    default BOARD_SD_PROFILE_CURRENT
    help
        Confirm the expansion-board revision before recording. Current Seeed
        documentation lists CS=GPIO3; older documentation/code listed GPIO21.

    config BOARD_SD_PROFILE_CURRENT
        bool "Current Sense expansion board (CS GPIO3)"

    config BOARD_SD_PROFILE_LEGACY
        bool "Legacy/documentation variant (CS GPIO21)"

    config BOARD_SD_PROFILE_CUSTOM
        bool "Custom pin mapping"
endchoice

config BOARD_SD_CUSTOM_CS_GPIO
    int "Custom SD CS GPIO"
    range 0 48
    default 3
    depends on BOARD_SD_PROFILE_CUSTOM

config BOARD_SD_CUSTOM_SCLK_GPIO
    int "Custom SD SCLK GPIO"
    range 0 48
    default 7
    depends on BOARD_SD_PROFILE_CUSTOM

config BOARD_SD_CUSTOM_MISO_GPIO
    int "Custom SD MISO GPIO"
    range 0 48
    default 8
    depends on BOARD_SD_PROFILE_CUSTOM

config BOARD_SD_CUSTOM_MOSI_GPIO
    int "Custom SD MOSI GPIO"
    range 0 48
    default 9
    depends on BOARD_SD_PROFILE_CUSTOM

endmenu
```

## firmware/sdkconfig.defaults
```kconfig
CONFIG_IDF_TARGET="esp32s3"
CONFIG_ESPTOOLPY_FLASHMODE_QIO=y
CONFIG_ESPTOOLPY_FLASHSIZE_8MB=y
CONFIG_PARTITION_TABLE_CUSTOM=y
CONFIG_PARTITION_TABLE_CUSTOM_FILENAME="../../partitions.csv"
CONFIG_COMPILER_OPTIMIZATION_PERF=y
CONFIG_SPIRAM=y
CONFIG_SPIRAM_MODE_OCT=y
CONFIG_SPIRAM_SPEED_80M=y
CONFIG_SPIRAM_USE_MALLOC=y
CONFIG_ESP_DEFAULT_CPU_FREQ_MHZ_240=y
CONFIG_ESP32S3_INSTRUCTION_CACHE_32KB=y
CONFIG_ESP32S3_DATA_CACHE_64KB=y
CONFIG_ESP32S3_DATA_CACHE_LINE_64B=y
CONFIG_FREERTOS_HZ=1000
CONFIG_ESP_TASK_WDT_EN=y
CONFIG_ESP_TASK_WDT_INIT=y
CONFIG_FLASH_HUMAN_FACE_DETECT_MSRMNP_S8_V1=n
CONFIG_FLASH_ESPDET_PICO_224_224_FACE=y
CONFIG_FLASH_ESPDET_PICO_416_416_FACE=n
CONFIG_ESPDET_PICO_224_224_FACE=y
CONFIG_HUMAN_FACE_DETECT_MODEL_IN_FLASH_RODATA=y
CONFIG_LOG_DEFAULT_LEVEL_INFO=y
```
